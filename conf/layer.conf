## conf/layer.conf
```bitbake
# We have a conf and classes directory, add to BBPATH
BBPATH .= ":${LAYERDIR}"

# We have a recipes-* directories, add to BBFILES
BBFILES += "${LAYERDIR}/recipes-*/*/*.bb \
	${LAYERDIR}/recipes-*/*/*.bbappend"

BBFILE_COLLECTIONS += "cmf-filogic"
BBFILE_PATTERN_cmf-filogic = "^${LAYERDIR}/"
BBFILE_PRIORITY_cmf-filogic = "24"

LAYERSERIES_COMPAT_cmf-filogic = "dunfell"

require conf/distro/include/rdk-turris.inc
#require conf/include/rdk-external-src-platform.inc
```

## conf/machine/filogic830-32bit.conf
```bitbake
#@TYPE: Machine
#@NAME: mediatek filogic
#@NEEDED_BSPLAYERS: meta-filogic
#@DESCRIPTION: Machine configuration for running a RDK broadband on mediatek filogic
#@RDK_FLAVOR: rdkb

include conf/machine/filogic-32bit.conf

MACHINE_EXTRA_RRECOMMENDS += "kernel-modules"

MACHINE_IMAGE_NAME = "rdkb-generic-broadband-image"

MACHINEOVERRIDES .= ":broadband:filogic-32bit:mt7986-32bit"

PREFERRED_VERSION_xfsprogs = "4.8.0"
PREFERRED_VERSION_php_dunfell = "7.1.%"
PREFERRED_VERSION_php-native_dunfell = "7.1.%"

PREFERRED_VERSION_linux-libc-headers = "5.4"
PREFERRED_PROVIDER_hal-wifi = "hal-wifi-cfg80211"
PREFERRED_VERSION_iw_filogic = "5.%"
PREFERRED_VERSION_hostapd = "2.10"
PREFERRED_VERSION_wpa-supplicant = "2.10"

#masking files for dunfell build
require conf/include/filogic-bbmasks.inc
#require conf/include/rdk-external-src-platform.inc

DISTRO_FEATURES_append = " meshwifi"
DISTRO_FEATURES_append = " ipv6"
#DISTRO_FEATURES_append = " kernel_in_ubi"
# kernel 5.4 gold linker 'arm-rdk-linux-gnueabi-ld' not supported
#DISTRO_FEATURES_append = " referencepltfm "
#DISTRO_FEATURES_remove = " ld-is-gold"

#for sdk support
INHERIT_append = " uninative"
BB_SETSCENE_ENFORCE_WHITELIST_append = " %:* *:do_fetch *"

BOOT_SUFFIX = "bin"
MACHINE_FEATURES = "ext2 ipsec nfs pci smbfs usbgadget usbhost vfat"
```

## conf/machine/filogic880-logan_2022q3-ccn34.conf
```bitbake
#@TYPE: Machine
#@NAME: mediatek filogic
#@NEEDED_BSPLAYERS: meta-filogic
#@DESCRIPTION: Machine configuration for running a RDK broadband on mediatek filogic
#@RDK_FLAVOR: rdkb

include conf/machine/filogic.conf
include conf/machine/filogic880-logan_2022q3.conf

DISTRO_FEATURES_append = " ccn34"
DISTRO_FEATURES_append = " eagle"
DISTRO_FEATURES_remove = " meshwifi"
```
